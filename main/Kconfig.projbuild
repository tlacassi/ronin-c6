## main/Kconfig.projbuild
```kconfig
menu "Ronin bridge"
config RONIN_WIFI_SSID
    string "Wi-Fi SSID"
    default ""
config RONIN_WIFI_PASSWORD
    string "Wi-Fi password"
    default ""
config RONIN_BLE_NAME
    string "Exact advertised Ronin BLE name"
    default ""
config RONIN_BLE_TRACE
    bool "Trace received DUML frames over the local serial console"
    default n
endmenu
```

## sdkconfig.defaults
```kconfig
CONFIG_IDF_TARGET="esp32c6"
CONFIG_BT_ENABLED=y
CONFIG_BT_NIMBLE_ENABLED=y
CONFIG_BT_NIMBLE_ROLE_CENTRAL=y
CONFIG_BT_NIMBLE_ROLE_OBSERVER=y
CONFIG_ESP_COEX_SW_COEXIST_ENABLE=y
```
